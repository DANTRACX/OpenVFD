#include "REGISTRY.h"
#include "../../RES/MEM/MEM.h"

SETPOINTS_s SETPOINTS;
PROCESSVALUES_s PROCESSVALUES;
PARAMETERS_s PARAMETERS;

void REGISTRY_INIT(void)
{
    /* initialize the setpoints */
    SETPOINTS.ENABLE = 0;
    SETPOINTS.TARGET_TORQUE = 0;
    SETPOINTS.TARGET_FREQUENCY = 0;
    SETPOINTS.REVERSAL = 0;
    SETPOINTS.ENABLE_CURRENT_OVERDRIVE = 0;
    SETPOINTS.ENABLE_FREQUENCY_OVERDRIVE = 0;
    SETPOINTS.ENABLE_PROGMODE = 0;
    SETPOINTS.TRIGGER_PARAMETER_SAVE = 0;
    SETPOINTS.TRIGGER_UF_CALCULATION = 0;
    SETPOINTS.TRIGGER_RESET = 0;

    /* initialize the process values */
    PROCESSVALUES.DCBUS_VOLTAGE = 0;
    PROCESSVALUES.DCBUS_CURRENT = 0;
    PROCESSVALUES.MOTOR_FREQUENCY = 0;
    PROCESSVALUES.MOTOR_POWER = 0;
    PROCESSVALUES.MOTOR_VOLTAGE = 0;
    PROCESSVALUES.MOTOR_CURRENT = 0;
    PROCESSVALUES.SYSTEM_STATUS = 0;

    /* initialize the parameters before non-volatile memory read */
    PARAMETERS.MODBUS_ADDRESS = 0;
    PARAMETERS.MODBUS_BAUDRATE = 0;
    PARAMETERS.MODBUS_PARITY = 0;

    PARAMETERS.MOTOR_NOMINAL_VOLTAGE = 0;
    PARAMETERS.MOTOR_MINIMAL_VOLTAGE = 0;
    PARAMETERS.MOTOR_NOMINAL_FREQUENCY = 0;
    PARAMETERS.MOTOR_VOLTBOOST_FREQUENCY = 0;
    PARAMETERS.MOTOR_NOMINAL_FWD_CURRENT = 0;
    PARAMETERS.MOTOR_NOMINAL_REV_CURRENT = 0;
    PARAMETERS.MOTOR_OVERDRIVE_FWD_CURRENT = 0;
    PARAMETERS.MOTOR_OVERDRIVE_REV_CURRENT = 0;

    PARAMETERS.CONTROLLER_NOMINAL_FREQUENCY = 0;
    PARAMETERS.CONTROLLER_OVERDRIVE_FREQUENCY = 0;
    PARAMETERS.CONTROLLER_PROPORTIONAL_FACTOR = 0;
    PARAMETERS.CONTROLLER_INTEGRAL_FACTOR = 0;
    PARAMETERS.CONTROLLER_SAMPLETIME = 0;
    PARAMETERS.CONTROLLER_ENABLE_TIMEOUT = 0;
    PARAMETERS.CONTROLLER_OVERDRIVE_TIMEOUT = 0;
    PARAMETERS.CONTROLLER_OVERDRIVE_COOLDOWN = 0;
    PARAMETERS.CONTROLLER_NOMINAL_UMZ_TIMEOUT = 0;
    PARAMETERS.CONTROLLER_OVERDRIVE_UMZ_TIMEOUT = 0;
    PARAMETERS.CONTROLLER_DCBUS_UMZ_TIMEOUT = 0;
    PARAMETERS.CONTROLLER_DCBUS_NOMINAL_VOLTAGE = 0;
    PARAMETERS.CONTROLLER_DCBUS_MINIMAL_VOLTAGE = 0;
    PARAMETERS.CONTROLLER_DCBUS_MAXIMAL_VOLTAGE = 0;
    PARAMETERS.CONTROLLER_DCBUS_VOLTAGE_OFFSET = 0;
    PARAMETERS.CONTROLLER_DCBUS_CURRENT_OFFSET = 0;
    PARAMETERS.CONTROLLER_DCBUS_FAN_THRESHOLD = 0;
    PARAMETERS.CONTROLLER_DCBUS_MAXIMAL_TEMP = 0;
    PARAMETERS.CONTROLLER_MOTOR_FAN_THRESHOLD = 0;
    PARAMETERS.CONTROLLER_MOTOR_MAXIMAL_TEMP = 0;
    PARAMETERS.CONTROLLER_PWM_FREQUENCY = 0;
    PARAMETERS.CONTROLLER_PWM_DEADTIME = 0;
    PARAMETERS.CONTROLLER_PWM_DEADTIME_PRESCALING = 0;

    PROCESSVALUES.SYSTEM_STATUS |= (SYSTEM_STATUS_INIT);

    if(REGISTRY_POPEEMEM() == -1)
    {
        PROCESSVALUES.SYSTEM_STATUS |= (SYSTEM_STATUS_ERROR);
    }

    else
    {
        /* limit the sample time to max. 1 sec */
        if(PARAMETERS.CONTROLLER_SAMPLETIME > 1000000)
        {
            PARAMETERS.CONTROLLER_SAMPLETIME = 1000000;
        }

        PROCESSVALUES.SYSTEM_STATUS &= ~(SYSTEM_STATUS_INIT);
        PROCESSVALUES.SYSTEM_STATUS |=  (SYSTEM_STATUS_STOP);
    }
}

void REGISTRY_PUSHEEMEM(void)
{
    MEM_WRITE(0, &PARAMETERS, sizeof(PARAMETERS_s));

    /* trigger the watchdog to restart the program */
    while(1);
}

int8_t REGISTRY_POPEEMEM(void)
{
    return MEM_READ(0, &PARAMETERS, sizeof(PARAMETERS_s));
}
